## drivers/input/fingerprint/Kconfig
```kconfig
#
# Fingerprint driver configuration
#

if MACH_ASUS_X00T

menuconfig INPUT_FINGERPRINT
	bool "Fingerprint"
	help
	  Say Y here, and a list of supported fingerprint will be displayed.
	  This option doesn't affect the kernel.

	  If unsure, say Y.

if INPUT_FINGERPRINT

config CDFINGER_FP
	bool "Fingerprint cdfinger"
	help
	  Say Y here if you use common fp.

	  If unsure, say N.

config GOODIX_FP
	bool "Fingerprint goodix"
	help
	  Say Y here if you use common fp.

	  If unsure, say N.

endif

endif
```
